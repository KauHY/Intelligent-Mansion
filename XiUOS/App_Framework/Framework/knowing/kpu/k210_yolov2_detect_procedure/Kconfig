## XiUOS/App_Framework/Framework/knowing/kpu/k210_yolov2_detect_procedure/Kconfig
```kconfig
menuconfig USING_K210_YOLOV2_DETECT
    bool "k210 yolov2 detect procedure"
	depends on USING_KPU_PROCESSING
    default n

config KPU_DEV_DRIVER
    string "Set kpu dev path"
    default "/dev/kpu_dev"

config PHOTO_WIFI_TCP
    bool "Send face photos through onboard ESP8285 TCP (dedicated UART1)"
    depends on USING_K210_YOLOV2_DETECT && ADD_XIZI_FEATURES && BOARD_EDU_RISCV64_EVB
    depends on BSP_USING_LCD && BSP_USING_UART1 && BSP_USING_GPIO && !SEPARATE_COMPILE
    depends on !ADAPTER_ESP8285_WIFI
    default n
    help
      Requires UART1 TX=7 RX=6 and local photo_wifi_config.h.
      Owns UART1 and Wi-Fi EN pin 8. Do not run other Wi-Fi/UART1 tests.
      PC receiver: pc_bridge/tcp_bridge.py. Serial photo commands disabled.

config CAMERA_DEV_DRIVER
    string "Set camera dev path for kpu"
    default "/dev/camera_dev"

config KPU_LCD_DEV_DRIVER
    string "Set lcd dev path for kpu"
    default "/dev/lcd_dev"



config K210_MODEL_BUILTIN
    bool "Embed FACE model and parameters in firmware (no USB needed)"
    depends on USING_K210_YOLOV2_DETECT && ADD_XIZI_FEATURES && !SEPARATE_COMPILE
    default n
    help
      Includes 388776 bytes of aligned model data. No second heap copy.
      Disable MOUNT_USB if no other application needs the USB disk.
```
